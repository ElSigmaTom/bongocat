#include <Wire.h>
#include <Adafruit_GFX.h>
#include <Adafruit_SSD1306.h>

// Define display dimensions
#define SCREEN_WIDTH 128
#define SCREEN_HEIGHT 64

// OLED reset pin not used for I2C
#define OLED_RESET -1
#define I2C_ADDRESS 0x3C

// Initialize the display
Adafruit_SSD1306 display(SCREEN_WIDTH, SCREEN_HEIGHT, &Wire, OLED_RESET);

// Define button pins
#define LEFTBUTTON 13  // GPIO 13 (D7 on NodeMCU)
#define RIGHTBUTTON 14 // GPIO 14 (D5 on NodeMCU)

// Bitmap data placeholders (replace with actual bitmap data)
const unsigned char _pawsonair[] PROGMEM = {
	0x00, 0x00, 0x00, 0x00, 0x00, 0x00, 0x00, 0x00, 0x00, 0x00, 0x00, 0x00, 0x00, 0x00, 0x00, 0x00, 
	0x00, 0x00, 0x00, 0x00, 0x00, 0x00, 0x00, 0x00, 0x00, 0x00, 0x00, 0x00, 0x00, 0x00, 0x00, 0x00, 
	0x00, 0x00, 0x00, 0x00, 0x00, 0x00, 0x00, 0x00, 0x00, 0x00, 0x00, 0x00, 0x00, 0x00, 0x00, 0x00, 
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	0x00, 0x00, 0x00, 0x00, 0x00, 0x00, 0x00, 0x00, 0x00, 0x00, 0x00, 0x00, 0x00, 0x1f, 0x80, 0x00
  };
const unsigned char _rightpawontable[] PROGMEM = {
	0x00, 0x00, 0x00, 0x00, 0x00, 0x00, 0x00, 0x00, 0x00, 0x00, 0x00, 0x00, 0x00, 0x00, 0x00, 0x00, 
	0x00, 0x00, 0x00, 0x00, 0x00, 0x00, 0x00, 0x00, 0x00, 0x00, 0x00, 0x00, 0x00, 0x00, 0x00, 0x00, 
	0x00, 0x00, 0x00, 0x00, 0x00, 0x00, 0x00, 0x00, 0x00, 0x00, 0x00, 0x00, 0x00, 0x00, 0x00, 0x00, 
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	0x00, 0x00, 0x00, 0x00, 0x00, 0x00, 0x00, 0x00, 0x00, 0x00, 0x00, 0x00, 0x00, 0x1f, 0x80, 0x00
};
const unsigned char _leftpawontable[] PROGMEM = {
	0x00, 0x00, 0x00, 0x00, 0x00, 0x00, 0x00, 0x00, 0x00, 0x00, 0x00, 0x00, 0x00, 0x00, 0x00, 0x00, 
	0x00, 0x00, 0x00, 0x00, 0x00, 0x00, 0x00, 0x00, 0x00, 0x00, 0x00, 0x00, 0x00, 0x00, 0x00, 0x00, 
	0x00, 0x00, 0x00, 0x00, 0x00, 0x00, 0x00, 0x00, 0x00, 0x00, 0x00, 0x00, 0x00, 0x00, 0x00, 0x00, 
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	0x00, 0x00, 0x00, 0x00, 0x00, 0x00, 0x00, 0x00, 0x00, 0x00, 0x00, 0x00, 0x00, 0x1f, 0x80, 0x00
};
const unsigned char _pawsontable[] PROGMEM = {
	0x00, 0x00, 0x00, 0x00, 0x00, 0x00, 0x00, 0x00, 0x00, 0x00, 0x00, 0x00, 0x00, 0x00, 0x00, 0x00, 
	0x00, 0x00, 0x00, 0x00, 0x00, 0x00, 0x00, 0x00, 0x00, 0x00, 0x00, 0x00, 0x00, 0x00, 0x00, 0x00, 
	0x00, 0x00, 0x00, 0x00, 0x00, 0x00, 0x00, 0x00, 0x00, 0x00, 0x00, 0x00, 0x00, 0x00, 0x00, 0x00, 
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	0x00, 0x00, 0x00, 0x00, 0x00, 0x00, 0x00, 0x00, 0x00, 0x00, 0x00, 0x00, 0x00, 0x1f, 0x80, 0x00
};

void setup() {
    // Initialize Serial for debugging
    Serial.begin(115200);

    // Initialize the OLED display
    if (!display.begin(SSD1306_SWITCHCAPVCC, I2C_ADDRESS)) {
        Serial.println(F("SSD1306 allocation failed"));
        for (;;); // Stop if display initialization fails
    }

    // Clear the display
    display.clearDisplay();
    display.drawBitmap(0, 0, _pawsonair, 128, 40, SSD1306_WHITE);
    display.display(); // Update display to show initial image

    // Initialize button pins with internal pull-up resistors
    pinMode(LEFTBUTTON, INPUT_PULLUP);
    pinMode(RIGHTBUTTON, INPUT_PULLUP);

    Serial.println(F("Setup complete. Waiting for button press..."));
}

// Variables for timing and button states
unsigned long bothButtonsPressStartTime = 0;
unsigned long lastToggleTime = 0;
unsigned long toggleInterval = 500; // Initial interval of 500 ms
bool displayingLeft = true; // Start with left image
bool prevButtonStateLeft = false;
bool prevButtonStateRight = false;

void loop() {
    // Read button states
    bool buttonStateLeft = digitalRead(LEFTBUTTON) == LOW;
    bool buttonStateRight = digitalRead(RIGHTBUTTON) == LOW;
    unsigned long currentTime = millis();

    // Handle both buttons pressed logic
    if (buttonStateLeft && buttonStateRight) {
        // Both buttons are pressed
        if (bothButtonsPressStartTime == 0) {
            bothButtonsPressStartTime = currentTime;
            lastToggleTime = currentTime;
            display.clearDisplay();
            display.drawBitmap(0, 0, _pawsontable, 128, 40, SSD1306_WHITE);
            display.display();
            Serial.println(F("Both buttons pressed, showing paws on table."));
        } else {
            unsigned long elapsedTime = currentTime - bothButtonsPressStartTime;
            if (elapsedTime > 500) {
                if (currentTime - lastToggleTime >= toggleInterval) {
                    display.clearDisplay();
                    if (displayingLeft) {
                        display.drawBitmap(0, 0, _leftpawontable, 128, 40, SSD1306_WHITE);
                        Serial.println(F("Toggling: Showing left paw on table."));
                    } else {
                        display.drawBitmap(0, 0, _rightpawontable, 128, 40, SSD1306_WHITE);
                        Serial.println(F("Toggling: Showing right paw on table."));
                    }
                    display.display();
                    displayingLeft = !displayingLeft;
                    lastToggleTime = currentTime;

                    if (toggleInterval > 20) {
                        toggleInterval -= 25;
                    }
                }
            }
        }
    } else if (buttonStateLeft) {
        // Only left button is pressed
        if (buttonStateLeft != prevButtonStateLeft || prevButtonStateRight) {
            bothButtonsPressStartTime = 0;
            toggleInterval = 500; // Reset interval
            display.clearDisplay();
            display.drawBitmap(0, 0, _leftpawontable, 128, 40, SSD1306_WHITE);
            display.display();
            Serial.println(F("Left button pressed, showing left paw on table."));
        }
    } else if (buttonStateRight) {
        // Only right button is pressed
        if (buttonStateRight != prevButtonStateRight || prevButtonStateLeft) {
            bothButtonsPressStartTime = 0;
            toggleInterval = 500; // Reset interval
            display.clearDisplay();
            display.drawBitmap(0, 0, _rightpawontable, 128, 40, SSD1306_WHITE);
            display.display();
            Serial.println(F("Right button pressed, showing right paw on table."));
        }
    } else {
        // No buttons or previous button state has changed
        if (bothButtonsPressStartTime != 0 || prevButtonStateLeft || prevButtonStateRight) {
            bothButtonsPressStartTime = 0;
            toggleInterval = 500; // Reset interval
            display.clearDisplay();
            display.drawBitmap(0, 0, _pawsonair, 128, 40, SSD1306_WHITE);
            display.display();
            Serial.println(F("No buttons pressed, showing paws on air."));
        }
    }

    // Update previous button states
    prevButtonStateLeft = buttonStateLeft;
    prevButtonStateRight = buttonStateRight;

    // Add a small delay to avoid rapid loop execution
    delay(10);
}